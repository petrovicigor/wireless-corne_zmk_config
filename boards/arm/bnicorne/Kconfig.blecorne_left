## boards/arm/bnicorne/Kconfig.blecorne_left
```kconfig
#
# Copyright (c) 2024 Kyle Brown
# SPDX-License-Identifier: MIT
#

config BOARD_BLECORNE_LEFT
    select SOC_NRF52840_QIAA
```

## boards/arm/bnicorne/board.yml
```yaml
boards:
  - name: blecorne_left
    full_name: Boardsource BLECORNE Left
    vendor: boardsource
    socs:
    - name: nrf52840
  - name: blecorne_right
    full_name: Boardsource BLECORNE Right
    vendor: boardsource
    socs:
    - name: nrf52840
```

## config/west.yml
```yaml
manifest:
  remotes:
    - name: zmkfirmware
      url-base: https://github.com/zmkfirmware
    - name: urob
      url-base: https://github.com/urob
  projects:
    - name: zmk
      remote: zmkfirmware
      revision: main
      import: app/west.yml
    # urob's tri-state module for better app-switcher (Cmd+Tab) behavior
    - name: zmk-tri-state
      remote: urob
      revision: main
  self:
    path: config
```
